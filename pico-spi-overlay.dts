/dts-v1/;
/plugin/;

/ {
    compatible = "brcm,bcm2835";

    fragment@0 {
        target = <&spi0>;
        __overlay__ {
            status = "okay";

            #address-cells = <1>;
            #size-cells = <0>;

            pico@0 {
                compatible = "custom,pico-spi";
                reg = <0>;                  // CS0
                spi-max-frequency = <1000000>;
                spi-cpol;
                spi-cpha;
            };
        };
    };
};